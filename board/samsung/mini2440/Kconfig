## board/samsung/mini2440/Kconfig
```kconfig
if TARGET_MINI2440

config SYS_BOARD
	default "mini2440"

config SYS_VENDOR
	default "samsung"

config SYS_SOC
	default "s3c24x0"

config SYS_CONFIG_NAME
	default "mini2440"

config S3C24X0
        bool "Support S3C24X0 cpu"

config S3C2440
        bool "Support S3C2440 cpu"

endif
```

## configs/mini2440_defconfig
```kconfig
CONFIG_ARM=y
CONFIG_CPU_ARM920T=y
CONFIG_S3C24X0=y
CONFIG_S3C2440=y
CONFIG_S3C2440_GPIO=n
CONFIG_TARGET_MINI2440=y
CONFIG_SYS_TEXT_BASE=0x000
CONFIG_ENV_SIZE=0x10000
CONFIG_ENV_OFFSET=0x3FC000
CONFIG_ENV_SECT_SIZE=0x4000
CONFIG_NR_DRAM_BANKS=1
CONFIG_SYS_MALLOC_F=y
CONFIG_SYS_MALLOC_F_LEN=0x2000
CONFIG_SPL=n
CONFIG_SPL_BUILD=n
CONFIG_IDENT_STRING="for MINI2440"
CONFIG_SILENT_CONSOLE=y
CONFIG_CONSOLE_MUX=y
CONFIG_SYS_PROMPT="MINI2440 # "
CONFIG_ERRNO_STR=y
CONFIG_OF_BOARD_SETUP=n
```
